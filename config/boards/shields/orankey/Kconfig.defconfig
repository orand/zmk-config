## config/boards/shields/orankey/Kconfig.defconfig
```kconfig
# Copyright (c) 2022 The ZMK Contributors
# SPDX-License-Identifier: MIT

if SHIELD_ORANKEY_LEFT

config ZMK_KEYBOARD_NAME
	default "Orankey"

config ZMK_SPLIT_ROLE_CENTRAL
	default y

endif

if SHIELD_ORANKEY_LEFT || SHIELD_ORANKEY_RIGHT

config ZMK_SPLIT
	default y

endif
```

## config/boards/shields/orankey/Kconfig.shield
```kconfig
# Copyright (c) 2022 The ZMK Contributors
# SPDX-License-Identifier: MIT

config SHIELD_ORANKEY_LEFT
	def_bool $(shields_list_contains,orankey_left)

config SHIELD_ORANKEY_RIGHT
	def_bool $(shields_list_contains,orankey_right)
```
